## firmware/build-m4/Kconfig/boards/Kconfig.doit_esp32_devkit_v1
```kconfig
# Load board Kconfig descriptions.
osource "C:/Users/gabri/Documents/projeto_embarcados/zephyrproject/zephyr/boards/others/doit_esp32_devkit_v1/Kconfig.doit_esp32_devkit_v1"
```

## firmware/build-m4/Kconfig/boards/Kconfig.sysbuild
```kconfig
# Load Sysbuild board Kconfig descriptions.
osource "C:/Users/gabri/Documents/projeto_embarcados/zephyrproject/zephyr/boards/others/doit_esp32_devkit_v1/Kconfig.sysbuild"
```

## firmware/tests/api_mock/testcase.yaml
```yaml
tests:
  epi.api_mock:
    tags: epi api
    integration_platforms:
      - native_sim
```

## firmware/tests/epi_names/testcase.yaml
```yaml
tests:
  epi.epi_names:
    tags: epi names
    integration_platforms:
      - native_sim
```

## firmware/tests/epi_state/testcase.yaml
```yaml
tests:
  epi.epi_state:
    tags: epi state
    integration_platforms:
      - native_sim
```

## firmware/tests/json_codec/build/Kconfig/boards/Kconfig.defconfig
```kconfig
# Load Zephyr board defconfig descriptions.
osource "C:/Users/gabri/Documents/projeto_embarcados/zephyrproject/zephyr/boards/native/native_sim/Kconfig.defconfig"
```

## firmware/tests/json_codec/build/Kconfig/boards/Kconfig.native_sim
```kconfig
# Load board Kconfig descriptions.
osource "C:/Users/gabri/Documents/projeto_embarcados/zephyrproject/zephyr/boards/native/native_sim/Kconfig.native_sim"
```

## firmware/tests/json_codec/build/Kconfig/boards/Kconfig.sysbuild
```kconfig
# Load Sysbuild board Kconfig descriptions.
osource "C:/Users/gabri/Documents/projeto_embarcados/zephyrproject/zephyr/boards/native/native_sim/Kconfig.sysbuild"
```

## firmware/tests/json_codec/testcase.yaml
```yaml
tests:
  epi.json_codec:
    tags: epi json
    integration_platforms:
      - native_sim
```

## firmware/tests/validation/testcase.yaml
```yaml
tests:
  epi.validation:
    tags: epi validation
    integration_platforms:
      - native_sim
```

## firmware/tests/zbus_flow/testcase.yaml
```yaml
tests:
  epi.zbus_flow:
    tags: epi zbus
    integration_platforms:
      - native_sim
```

## west.yml
```yaml
# Manifesto west do EPI Guard.
# Permite `west init -l epi-guard` (CI e workspaces novos): o Zephyr v4.4.0
# vira projeto gerenciado pelo `west update`. Sem modulos externos —
# os testes em native_sim usam apenas a arvore principal do Zephyr.
manifest:
  remotes:
    - name: zephyrproject-rtos
      url-base: https://github.com/zephyrproject-rtos

  projects:
    - name: zephyr
      remote: zephyrproject-rtos
      revision: v4.4.0
      clone-depth: 1
      import: false

  self:
    path: epi-guard
```
